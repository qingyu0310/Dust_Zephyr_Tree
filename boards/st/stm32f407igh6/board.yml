## boards/st/stm32f407igh6/board.yml
```yaml
board:
  name: stm32f407igh6
  full_name: Custom STM32F407IGH6 Board
  vendor: st
  socs:
    - name: stm32f407xx
```

## boards/st/stm32g431cbtx/Kconfig.stm32g431cbtx
```kconfig
# Copyright (c) 2026 qingyu
# SPDX-License-Identifier: Apache-2.0

# Custom board for STM32G431CBTx
config BOARD_STM32G431CBTX
	select SOC_STM32G431XX
```

## boards/st/stm32g431cbtx/stm32g431cbtx_defconfig
```kconfig
# SPDX-License-Identifier: Apache-2.0
# Custom board for STM32G431CBTx

CONFIG_SERIAL=y
CONFIG_CONSOLE=y
CONFIG_UART_CONSOLE=y
CONFIG_GPIO=y
```

## ci/zephyr/Kconfig
```kconfig
# framework 聚合 Kconfig（CI 骨架用）
# 与 framework/zephyr/Kconfig 同构；rsource 相对 ci/zephyr/
rsource "../../framework/drivers/Kconfig"
rsource "../../framework/algorithm/Kconfig"
rsource "../../framework/modules/Kconfig"
rsource "../../framework/topic/Kconfig"
rsource "../../framework/cmd/Kconfig"
rsource "../../framework/drivers/communication/stream/usb/Kconfig"
# init 无独立 Kconfig 且始终编译，不 rsource
```

## drivers/Kconfig
```kconfig
config DUST_DEV_FSMC
    bool "STM32 FSMC LCD controller (HX8357DN 8080)"
    default n
    help
      FSMC 底层设备驱动：读 lcd_fsmc 节点时序/背光属性，配置 Bank 寄存器。

config DUST_DEV_FSMC_INIT_PRIORITY
    int "FSMC init priority"
    default 40
    help
      FSMC 设备初始化优先级（POST_KERNEL 阶段，需早于 LCD 业务线程）。

# USB 板卡底层 HAL（2026-08-09 从 framework/drivers/communication/stream/usb 下沉）
config DUST_USB_DEVICE_HAL_HPM
    bool "HPMicro EHCI USB HAL"
    default n

config DUST_USB_DEVICE_HAL_STM32
    bool "STM32 OTG FS USB HAL"
    default n
    select USE_STM32_HAL_PCD
    select USE_STM32_HAL_PCD_EX
    select USE_STM32_LL_USB
    help
      STM32F407 OTG FS 板卡底层 HAL（参考 STM32Cube USB_DEVICE CDC 设置，2026-08-13）。
      select USE_STM32_HAL_PCD* 触发 hal_stm32 模块编译 stm32f4xx_hal_pcd{,_ex}.c；
      USE_STM32_LL_USB 编译 stm32f4xx_ll_usb.c（HAL_PCD 依赖的 USB_* 底层函数）。

# EtherCAT ESC HAL（2026-10-29 从 sdk_glue_user 下沉，照 USB 分层）
# PHY 是 framework/drivers/device 下的设备模块，由业务线程（trd）组装时选用。
config DUST_ECAT_HAL_HPM
    bool "HPMicro ESC EtherCAT HAL"
    default n
    select CLOCK_CONTROL
    select GPIO
    select PINCTRL
    select HPM_ESC
    help
      HPMicro 片内 ESC 的 HAL 实现：EcatEsc 契约的厂商落地（含 SII 两种介质）。
      只提供底层 API 的隔离层，不含 PHY。

# fatal 异常栈帧转储（芯片相关，2026-10-20）
config DUST_FATAL_ESF_HPM
    bool "HPM RISC-V esf dump"
    default n
    select RISCV
    help
      RISC-V 异常栈帧转储：mcause / mtval / mepc / mstatus / ra / a0 / a1。
      fatal.cpp 内提供 __weak 空实现，未开启时链接不报错。

config DUST_FATAL_ESF_STM32
    bool "STM32 Cortex-M esf dump"
    default n
    select CPU_CORTEX_M
    help
      Cortex-M 异常栈帧转储：pc / xpsr / lr。
      fatal.cpp 内提供 __weak 空实现，未开启时链接不报错。
```

## dts/bindings/encoder/st,stm32-encoder.yaml
```yaml
# Copyright (c) 2026, qingyu
# SPDX-License-Identifier: Apache-2.0

description: STM32 TIM quadrature encoder (user-layer driver, hardware encoder mode)

# Zephyr 设备模型驱动的节点：TIM 实例取自父节点 reg，引脚取自本节点 pinctrl-0
# （见 drivers/device/encoder）。
compatible: "st,stm32-encoder"

include: [base.yaml, pinctrl-device.yaml]

properties:
  pinctrl-0:
    required: true

  pinctrl-names:
    required: true

  st,counts-per-revolution:
    type: int
    required: true
    description: |
      编码器每圈脉冲数（A 相或 B 相单相脉冲）。硬件 X4 解码 → 实际计数 = 本值 × 4。

  st,input-filter-level:
    type: int
    default: 1
    enum:
      - 0
      - 1
      - 2
      - 3
      - 4
      - 5
      - 6
      - 7
      - 8
      - 9
      - 10
      - 11
      - 12
      - 13
      - 14
      - 15
    description: |
      输入滤波档位，映射见 zephyr/dts/bindings/sensor/st,stm32-qdec.yaml。
      0 = 不滤波；1 = fCK_INT / N=2（当前代码用的 FDIV1_N2，保持一致）。
```

## dts/bindings/gpio/heart-beat.yaml
```yaml
description: Heart beat indicator (GPIO output toggle)

compatible: "heart-beat"

include: [base.yaml]

properties:
  gpios:
    type: phandle-array
    required: true
```

## dts/bindings/mtd/winbond,w25q128.yaml
```yaml
description: Winbond W25Q128 SPI NOR Flash

include: [spi-device.yaml]

compatible: "winbond,w25q128"

on-bus: spi
```

## dts/bindings/usb/st,st-dustusb.yaml
```yaml
# Copyright (c) 2026, qingyu
# SPDX-License-Identifier: Apache-2.0

description: STM32 OTGFS controller (self-implemented stack)

compatible: "st,st-dustusb"

include: [usb-ep.yaml, pinctrl-device.yaml]

properties:
  reg:
    required: true

  interrupts:
    required: true

  pinctrl-0:
    required: true

  pinctrl-names:
    required: true

  ram-size:
    type: int
    required: true
    description: |
      Size of USB dedicated RAM. STM32 SOC's reference
      manual defines a shared FIFO size.

  phys:
    type: phandle
    description: PHY provider specifier

  clocks:
    required: true
```

## modules/usb/dts/bindings/usb/hpmicro,hpm-qingyuusb.yaml
```yaml
description: HPMicro QingyuUSB Controller (self-implemented stack)

compatible: "hpmicro,hpm-qingyuusb"

include: ["usb-ep.yaml", "pinctrl-device.yaml"]

properties:
  reg:
    required: true

  interrupts:
    required: true

  clk-name:
    type: int
    required: true
    description: USB clock name
```

## zephyr/boards/st/stm32f407igh6/Kconfig.stm32f407igh6
```kconfig
# Copyright (c) 2026 blinky project
# SPDX-License-Identifier: Apache-2.0

# Custom board for STM32F407IGH6
config BOARD_STM32F407IGH6
	select SOC_STM32F407XG
```

## zephyr/boards/st/stm32g431cbtx/board.yml
```yaml
board:
  name: stm32g431cbtx
  full_name: Custom STM32G431CBTx Board
  vendor: st
  socs:
    - name: stm32g431xx
```

## zephyr/dts/bindings/fsmc/st,fsmc-lcd.yaml
```yaml
description: STM32 FSMC 8080 LCD 控制器（Bank4，16 位数据）

compatible: "st,fsmc-lcd"

include: [base.yaml, pinctrl-device.yaml]

properties:
  bank:
    type: int
    required: true
  data-width:
    type: int
    required: true
  read-addr-setup-cycles:
    type: int
    required: true
  read-data-setup-cycles:
    type: int
    required: true
  write-addr-setup-cycles:
    type: int
    required: true
  write-data-setup-cycles:
    type: int
    required: true
  backlight-gpios:
    type: phandle-array
    required: true
```

## zephyr/dts/bindings/usb/hpmicro,hpm-dustusb.yaml
```yaml
description: HPMicro DustUSB Controller (self-implemented stack)

compatible: "hpmicro,hpm-dustusb"

include: ["usb-ep.yaml", "pinctrl-device.yaml"]

properties:
  reg:
    required: true

  interrupts:
    required: true

  clk-name:
    type: int
    required: true
    description: USB clock name
```
