
/*
 * Copyright (c) 2024-2025 HPMicro
 *
 * SPDX-License-Identifier: BSD-3-Clause
 *
 */

#include <string.h>
#include <stdio.h>
#include "ecat_zephyr_port.h"
#include <zephyr/kernel.h>
#include <errno.h>
#include "ecat_port_hw.h"
#include "hpm_i2c_drv.h"
#include "hpm_romapi.h"
#include "hpm_ecat_hw.h"
#include "hpm_ppor_drv.h"
#include "hpm_sysctl_drv.h"
#include "esc.h"

/* removed in newer SSC esc.h, reading it acknowledges Sync0/Sync1 interrupts */
#ifndef ESC_DC_SYNC_STATUS
#define ESC_DC_SYNC_STATUS (0x0982)
#endif

#if defined(EOE_SUPPORTED) && EOE_SUPPORTED
#include "sys_arch.h" /* lwip sys_arch.h */
#endif

#if defined(ECAT_SSC_TIMER_USE_RTOS_TICK) && ECAT_SSC_TIMER_USE_RTOS_TICK
#if defined(__ENABLE_FREERTOS) && __ENABLE_FREERTOS
#include "FreeRTOS.h"
#include "task.h"
#endif /* __ENABLE_FREERTOS */
#endif /* ECAT_SSC_TIMER_USE_RTOS_TICK */

MEM_ADDR ESCMEM * pEsc;

/* weak declaration, aEepromData is generated by SSC tool to store eeprom data */
ATTR_WEAK unsigned char aEepromData[ESC_EEPROM_SIZE] = {0xa5, 0xa5, 0xa5, 0xa5};

void ecat_pdi_isr(void);
void ecat_sync0_isr(void);
void ecat_sync1_isr(void);

/* SSC 1ms timer */
#if defined(ECAT_SSC_TIMER_USE_RTOS_TICK) && ECAT_SSC_TIMER_USE_RTOS_TICK
#if defined(__ENABLE_FREERTOS) && __ENABLE_FREERTOS
static TickType_t time_base = 0;
void ecat_time_init_rtos(void);
#endif /* __ENABLE_FREERTOS */
#else
    static volatile UINT32 ecat_time_ms = 0;
    void ecat_timer_ms_enable(void);
#endif /* ECAT_SSC_TIMER_USE_RTOS_TICK */

/* I2C init actual EEPROM content function */
#if defined(ESC_EEPROM_EMULATION) && (!ESC_EEPROM_EMULATION)
hpm_stat_t esc_eeprom_content_init(void);
#endif

/* ecat hwardware init */
hpm_stat_t ecat_hardware_init(const struct device *esc_dev)
{
    hpm_stat_t stat;
    int eeprom_status;

#if defined(ESC_EEPROM_EMULATION) && ESC_EEPROM_EMULATION
    stat = ecat_flash_eeprom_init();
    if (stat != status_success) {
        ECAT_LOG("Flash simulation EEPROM initialization failed.\n");
        return stat;
    }

    hpm_esc_configure_eeprom(esc_dev, true, false);

    /* eeprom reload */
    ecat_eeprom_emulation_reload_response();

#else

    stat = esc_eeprom_content_init(); /* I2C init EEPROM context */
    if (stat != status_success) {
        ECAT_LOG("I2C initialize actual EEPROM content failed.\n");
        return stat;
    }

    init_esc_eeprom_pin(); /* config ESC pin for EEPROM */

    hpm_esc_configure_eeprom(esc_dev, false, ECAT_EEPROM_SIZE_BYTE > 256);
#endif


    /* Wait Loading ESC EEPROM and check */
    eeprom_status = hpm_esc_check_eeprom(esc_dev);
    if (eeprom_status != 0) {
        if (eeprom_status == -EBADMSG) {
            ECAT_LOG("EEPROM loading with checksum error.\n");
            ECAT_LOG("EtherCAT communication is possible even if the EEPROM is blank(checksum error), please update eeprom context.\n");
            /* not return */
        } else {
            ECAT_LOG("EEPROM loading failed, please check EEPROM setting.\n");
            return status_fail;
        }
    } else {
        ECAT_LOG("EEPROM loading successful, no checksum error.\n");
    }

    /* PHY reset（引脚复位；具体芯片的配置由 HAL 遍历 phys[] 完成） */
    hpm_esc_phy_reset(esc_dev, true);
    board_delay_ms(10);
    hpm_esc_phy_reset(esc_dev, false);
    board_delay_ms(150);

    /* Set PHY OFFSET */
    hpm_esc_configure_phy(esc_dev);

    hpm_esc_configure_signals(esc_dev);

    if (status_success == stat) {
#if defined(ECAT_SSC_TIMER_USE_RTOS_TICK) && ECAT_SSC_TIMER_USE_RTOS_TICK
        ecat_time_init_rtos();
#else
        /* Open Timer driver */
        ecat_timer_ms_enable();
#endif /* ECAT_SSC_TIMER_USE_RTOS_TICK */

        /* Initialize the EtherCAT Slave Interface of the SSC */
        HW_Init();

    } else {
        /* Close operation */
    }

    return stat;
}

#if defined(ECAT_SSC_TIMER_USE_RTOS_TICK) && ECAT_SSC_TIMER_USE_RTOS_TICK

#if defined(__ENABLE_FREERTOS) && __ENABLE_FREERTOS
void ecat_time_init_rtos(void)
{
    time_base = xTaskGetTickCount();
}

UINT32 HW_GetTimer(void)
{
    TickType_t current_ticks, elapsed_ticks;
    uint32_t elapsed_ms;

    current_ticks = xTaskGetTickCount();
    elapsed_ticks = current_ticks - time_base;
    elapsed_ms = elapsed_ticks * portTICK_PERIOD_MS;  /* calculate time based on freertos tick */

    return elapsed_ms;
}

void HW_ClearTimer(void)
{
    time_base = xTaskGetTickCount();  /* update time base */
}

#if defined(ECAT_TIMER_INT) && ECAT_TIMER_INT
/* freertos Tick Hook（1ms, configUSE_TICK_HOOK should be defined 1 in FreeRTOSConfig.h */
void vApplicationTickHook(void)
{
    ECAT_CheckTimer();
}
#endif /* ECAT_TIMER_INT */
#endif /* __ENABLE_FREERTOS */

#else

static void ecat_timer_expiry(struct k_timer *timer)
{
    ARG_UNUSED(timer);
    ecat_time_ms += ECAT_TIMER_INC_P_MS;
#if defined(ECAT_TIMER_INT) && ECAT_TIMER_INT
    ECAT_CheckTimer();
#endif

#if defined(EOE_SUPPORTED) && EOE_SUPPORTED
    sys_timer_callback();
#endif
}

K_TIMER_DEFINE(ecat_ms_timer, ecat_timer_expiry, NULL);

void ecat_timer_ms_enable(void)
{
    k_timer_start(&ecat_ms_timer, K_MSEC(1), K_MSEC(1));
}

UINT32 HW_GetTimer(void)
{
    return ecat_time_ms;
}

void HW_ClearTimer(void)
{
    ecat_time_ms = 0;
}
#endif /* ECAT_SSC_TIMER_USE_RTOS_TICK */

/* 中断上报钩子：由 HAL 注册（EcatHalHpm::OnPortIrq），
 * 端口层不直接调 SSC 的 PDI_Isr / Sync0_Isr / Sync1_Isr。 */
static ecat_port_irq_cb_t s_irq_cb = NULL;

void ecat_port_set_irq_cb(ecat_port_irq_cb_t cb)
{
    s_irq_cb = cb;
}

/* ECAT PDI IRQ handler */
void ecat_pdi_isr(void)
{
    if (s_irq_cb != NULL) {
        s_irq_cb(ECAT_PORT_IRQ_PDI);
    }
}

/* ECAT SYNC0 IRQ handler */
void ecat_sync0_isr(void)
{
#if defined(HPM_IP_FEATURE_ESC_BYTE_READ) && HPM_IP_FEATURE_ESC_BYTE_READ
    volatile UINT8 SyncState = 0;
    HW_EscReadByte(SyncState, 0x098E); /* Readbyte, acknowledge Sync0 */
#else
    volatile UINT32 SyncState = 0;
    HW_EscReadDWord(SyncState, ESC_DC_SYNC_STATUS); /* ReadDWord, acknowledge Sync0 and Sync1 */
#endif
    (void) SyncState;

    if (s_irq_cb != NULL) {
        s_irq_cb(ECAT_PORT_IRQ_SYNC0);
    }
}

/* ECAT SYNC1 IRQ handler */
void ecat_sync1_isr(void)
{
#if defined(HPM_IP_FEATURE_ESC_BYTE_READ) && HPM_IP_FEATURE_ESC_BYTE_READ
    volatile UINT8 SyncState = 0;
    HW_EscReadByte(SyncState, 0x098F); /* Readbyte, acknowledge Sync0 */
#else
    volatile UINT32 SyncState = 0;
    HW_EscReadDWord(SyncState, ESC_DC_SYNC_STATUS); /* ReadDWord, acknowledge Sync0 and Sync1 */
#endif
    (void) SyncState;

    if (s_irq_cb != NULL) {
        s_irq_cb(ECAT_PORT_IRQ_SYNC1);
    }
}

/* ECAT reset handler, please do necessary protection before resetting!!!! */
void ecat_reset_isr(void)
{
    /* SSC ESC reset Interrupt handler */
#if defined(ECAT_RESET_ESC_PERIPHERAL) && ECAT_RESET_ESC_PERIPHERAL
    /* keep phy in reset before reset esc peripheral */
    hpm_esc_phy_reset(ECAT_ESC_DEVICE, true);
    /* reset OTN module by sysctl */
    sysctl_resource_target_set_mode(HPM_SYSCTL, sysctl_resource_rst_otn, sysctl_resource_mode_force_off);
    while (sysctl_resource_target_is_busy(HPM_SYSCTL, sysctl_resource_rst_otn)) {
    }
    sysctl_resource_target_set_mode(HPM_SYSCTL, sysctl_resource_rst_otn, sysctl_resource_mode_force_on);
    while (sysctl_resource_target_is_busy(HPM_SYSCTL, sysctl_resource_rst_otn)) {
    }

    esc_hardware_init(HPM_ESC); /* reconfig ESC peripheral */
#elif defined(ECAT_RESET_ESC_WITH_MCU) && ECAT_RESET_ESC_WITH_MCU
    /* keep phy in reset before reset esc peripheral */
    hpm_esc_phy_reset(ECAT_ESC_DEVICE, true);
    ppor_sw_reset(HPM_PPOR, 2); /* software reset */
    while (1) {
    }
#else
    #error please specify ECAT reset type
#endif
}

UINT16 HW_Init(void)
{
    /* set esc register base address */
    pEsc = (MEM_ADDR ESCMEM *) hpm_esc_base(ECAT_ESC_DEVICE);

    return 0;
}

void HW_Release(void)
{
}

#if defined(UC_SET_ECAT_LED) && UC_SET_ECAT_LED
void HW_SetLed(UINT8 RunLed, UINT8 ErrLed)
{
    #warning "Please implement the function for MCU to control LED."
}
#endif

/* ENABLE_ESC_INT / DISABLE_ESC_INT are implemented in ecat_zephyr_port.c */

ATTR_RAMFUNC
uint8_t ecat_calculate_eeprom_config_data_checksum(const uint8_t *data, size_t size)
{
    uint8_t remainder = 0xFF; /* Initial remainder */
    uint8_t polynomial = 0x07; /* CRC-8 polynomial x^8 + x^2 + x + 1 */

    for (size_t i = 0; i < size; i++) {
        remainder ^= data[i]; /* XOR with byte */

        /* Perform polynomial division */
        for (int j = 0; j < 8; j++) {
            if (remainder & 0x80) { /* If high bit is set */
                remainder = (remainder << 1) ^ polynomial; /* XOR with polynomial */
            } else {
                remainder = (remainder << 1); /* Shift left */
            }
        }
    }

    return remainder;
}

#if defined(ESC_EEPROM_EMULATION) && ESC_EEPROM_EMULATION
ATTR_RAMFUNC
UINT16 ecat_eeprom_emulation_read(UINT32 wordaddr)
{
    if ((EepromReadSize == 4) || (EepromReadSize == 8)) {
        hpm_stat_t stat;
        uint16_t data[4] = {0};
        uint64_t data_total = 0;
        for (uint8_t i = 0; i < (EepromReadSize / EEPROM_WRITE_SIZE); i++) {
            stat = ecat_flash_eeprom_read(wordaddr + i, (uint8_t *)&data[i]);
            if (status_success != stat) {
                return ESC_EEPROM_EMULATION_ACK_ERROR;
            }
            data_total = data_total + (data[i] << i * (EEPROM_WRITE_SIZE * 8));
        }
        esc_write_eeprom_data(HPM_ESC, data_total); /* write to ESC register */
    } else {
        return ESC_EEPROM_EMULATION_ACK_ERROR;
    }

    return ESC_EEPROM_EMULATION_SUCCESS;
}

ATTR_RAMFUNC
UINT16 ecat_eeprom_emulation_write(UINT32 wordaddr)
{
    assert(EEPROM_WRITE_SIZE == 0x2);
    hpm_stat_t stat;
    uint16_t data, data_stored;
    data = (uint16_t)(esc_read_eeprom_data(HPM_ESC) & 0xFFFF); /* read from ESC register */
    if ((status_success != ecat_flash_eeprom_read(wordaddr, (uint8_t *)&data_stored)) || (data != data_stored)) {
        stat = ecat_flash_eeprom_write(wordaddr, (uint8_t *)&data);
        if (status_success != stat) {
            return ESC_EEPROM_EMULATION_ACK_ERROR;
        }
    }
    return ESC_EEPROM_EMULATION_SUCCESS;
}

ATTR_RAMFUNC
UINT16 ecat_eeprom_emulation_reload(void)
{
    hpm_stat_t stat;
    uint32_t reload_data = 0;
    uint16_t config_data[8] = {0xff};
    for (uint8_t i = 0; i < 8; i++) {
        stat = ecat_flash_eeprom_read(i, (uint8_t *)&config_data[i]);
        if (status_success != stat) {
            break;
        }
    }

    if (status_success != stat) {
        return ESC_EEPROM_EMULATION_ACK_ERROR; /* ack error */
    }

    uint8_t checksum = ecat_calculate_eeprom_config_data_checksum((uint8_t *)config_data, 14); /* word0 - word6 */
    if (checksum != config_data[7]) {
        return ESC_EEPROM_EMULATION_CHECKSUM_ERROR; /* checksum error */
    }

    /* build the value of eeprom emulation data */
    reload_data += config_data[4];                                    /* bit[15:0] */
    reload_data += ESC_ESC_CFG_ELDAP_GET(config_data[0] >> 8) << 16;  /* bit[16] */
    reload_data += ESC_ESC_CFG_ELP0_GET(config_data[0] >> 8) << 17;   /* bit[17] */
    reload_data += ESC_ESC_CFG_ELP1_GET(config_data[0] >> 8) << 18;   /* bit[18] */
    reload_data += ESC_ESC_CFG_ELP2_GET(config_data[0] >> 8) << 19;   /* bit[19] */
    reload_data += ESC_ESC_CFG_ELP3_GET(config_data[0] >> 8) << 20;   /* bit[20] */
    esc_write_eeprom_data(HPM_ESC, reload_data); /* write to ESC register */

    return ESC_EEPROM_EMULATION_SUCCESS;
}

ATTR_RAMFUNC
void ecat_eeprom_emulation_reload_response(void)
{
    if ((HPM_ESC->EEPROM_CTRL_STAT & ESC_EEPROM_CTRL_STAT_EE_EMU_MASK) == ESC_EEPROM_CTRL_STAT_EE_EMU_MASK) {
        if ((HPM_ESC->EEPROM_CTRL_STAT & ESC_EEPROM_CTRL_STAT_BUSY_MASK) == ESC_EEPROM_CTRL_STAT_BUSY_MASK) {
            uint16_t stat;
            uint8_t cmd = esc_get_eeprom_cmd(HPM_ESC);
            if (cmd == esc_eeprom_reload_cmd) {
                stat = ecat_eeprom_emulation_reload();
                if (stat == ESC_EEPROM_EMULATION_SUCCESS) {
                    esc_eeprom_emulation_ack(HPM_ESC, cmd, false, false);
                } else if (stat == ESC_EEPROM_EMULATION_CHECKSUM_ERROR) {
                    esc_eeprom_emulation_ack(HPM_ESC, cmd, false, true); /* checksum error */
                } else {
                    esc_eeprom_emulation_ack(HPM_ESC, cmd, true, false); /* ack error */
                }
            }
        }
    }
}

/* no need to implement if the written data is stored directly
during the EEPROM Write commands(pAPPL_EEPROM_Write) to the permanent memory  */
void ecat_eeprom_emulation_store(void)
{
}

#endif /* ESC_EEPROM_EMULATION */

/* In case that pAPPL_EEPROM_Reload is implemented the function
“HW_EepromReload()” is not used.*
SSC 的 ecatappl.c 无条件调用它，所以放在模拟开关外面：
非模拟模式（板上 I2C EEPROM）下 SSC 走 pEEPROM 缓冲，这里返回成功即可。 */
UINT16 HW_EepromReload(void)
{
    return ESC_EEPROM_EMULATION_SUCCESS;
}

/**
 * @brief Reads and copies data from a source to a destination in 4-byte chunks
 *
 * @param dest Pointer to the destination memory location
 * @param src Pointer to the source memory location
 * @param size Total number of bytes to be copied
 *
 * @note The source memory address must be 4-byte aligned.
 */
void hw_esc_read_4bytes(void *dest, const void *src, uint16_t size)
{
    assert(((uint32_t)src % 4) == 0); /* Ensure src is 4-byte aligned */

    uint32_t *d = (uint32_t *)dest;   /* Destination pointer, cast to 4-byte (uint32_t) */
    const uint32_t *s = (const uint32_t *)src; /* Source pointer, cast to 4-byte (const uint32_t) */

    uint16_t count = size / 4;       /* Number of 4-byte blocks to copy */
    uint16_t remainder = size % 4;   /* Remaining bytes after full 4-byte block copies */
    uint16_t index;

    /* Copy data in 4-byte chunks */
    for (index = 0; index < count; index++) {
        d[index] = s[index]; /* Always read in 4-byte */
    }

    /* Handle any remaining bytes after the last full 4-byte block */
    if (remainder > 0) {
        uint32_t last_4bytes = s[index]; /* Read the last 4-byte block */
        memcpy(&d[index], &last_4bytes, remainder); /* Copy only the remaining bytes */
    }
}

/* actual EEPROM initialization */
#if defined(ESC_EEPROM_EMULATION) && (!ESC_EEPROM_EMULATION)
#define ESC_EEPROM_DEVICE_ADDRESS (0x50U) /* ESC EEPROM device address */

/* check EtherCAT Slave Controller Configuration Area is first 8 words(1 word = 2 bytes) */
static hpm_stat_t ecat_i2c_eeprom_check_configuration_area(void)
{
    uint16_t config_data[8];
    uint8_t checksum;
    uint16_t subaddr = 0;
    subaddr = ((subaddr & 0xff) << 8) | ((subaddr & 0xff00) >> 8);
    /* read 16 bytes from address 0x0 */
    if (status_success != i2c_master_address_read(BOARD_ECAT_INIT_EEPROM_I2C, ESC_EEPROM_DEVICE_ADDRESS, (uint8_t *)&subaddr, 2, (uint8_t *)config_data, 16)) {
        return status_fail;
    }

    checksum = ecat_calculate_eeprom_config_data_checksum((uint8_t *)config_data, 14); /* calculate checksum value for word0 - word6 */

    /* Low byte contains remainder of division of word 0 to word 6 as unsigned number divided by the polynomial x8+x2+x+1(initial value 0xFF). */
    if (checksum != config_data[7]) {
        return status_invalid_argument; /* checksum error */
    }

    return status_success;
}

hpm_stat_t esc_eeprom_content_init(void)
{
    hpm_stat_t stat;
    i2c_config_t config;
    uint32_t freq;

    /* If the value of aEepromData is the initial value in weak declaration, it means there is no valid data in aEepromData */
    if ((aEepromData[0] == 0xa5) && (aEepromData[1] == 0xa5) && (aEepromData[2] == 0xa5) && (aEepromData[3] == 0xa5)) {
        ECAT_LOG("No EEPROM content in PROGRAM.\n");
        return status_success;
    }

    clock_add_to_group(BOARD_ECAT_INIT_EEPROM_I2C_CLK, 0);
    init_esc_eeprom_as_i2c_pin();

    config.i2c_mode = i2c_mode_normal;
    config.is_10bit_addressing = false;
    freq = clock_get_frequency(BOARD_ECAT_INIT_EEPROM_I2C_CLK);
    stat = i2c_init_master(BOARD_ECAT_INIT_EEPROM_I2C, freq, &config);
    if (stat != status_success) {
        ECAT_LOG("I2C Init failed\n");
        return status_fail;
    }

    bool require_init_eeprom = false;
    stat = ecat_i2c_eeprom_check_configuration_area();
    if (status_success == stat) {
        /* if eeprom configuration data checksum pass, then check Product Code and Revision Number */
#if defined(ECAT_EEPROM_CHECK_PRODUCT_CODE_AND_REVISION) && ECAT_EEPROM_CHECK_PRODUCT_CODE_AND_REVISION
        uint32_t product_code, revision_num;
        uint16_t subaddr;

        subaddr = ESC_EEPROM_PRODUCT_CODE_WORD_INDEX * 2;
        subaddr = ((subaddr & 0xff) << 8) | ((subaddr & 0xff00) >> 8);
        /* read 4 byte from address ESC_EEPROM_PRODUCT_CODE_WORD_INDEX * 2 */
        if (status_success != i2c_master_address_read(BOARD_ECAT_INIT_EEPROM_I2C, ESC_EEPROM_DEVICE_ADDRESS, (uint8_t *)&subaddr, 2, (uint8_t *)&product_code, 4)) {
            ECAT_LOG("I2C read ESC EEPROM content failed\n");
            return status_fail;
        }

        subaddr = ESC_EEPROM_REVISION_NUM_WORD_INDEX * 2;
        subaddr = ((subaddr & 0xff) << 8) | ((subaddr & 0xff00) >> 8);
        /* read 4 byte from address ESC_EEPROM_REVISION_NUM_WORD_INDEX * 2 */
        if (status_success != i2c_master_address_read(BOARD_ECAT_INIT_EEPROM_I2C, ESC_EEPROM_DEVICE_ADDRESS, (uint8_t *)&subaddr, 2, (uint8_t *)&revision_num, 4)) {
            ECAT_LOG("I2C read ESC EEPROM content failed\n");
            return status_fail;
        }

        /* if Procde Code not match or aEepromData[ESC_EEPROM_REVISION_NUM_WORD_INDEX] > stored revesion, require to update eeprom by aEepromData */
        if ((product_code != ((uint32_t *)aEepromData)[ESC_EEPROM_PRODUCT_CODE_WORD_INDEX / 2]) || (revision_num < ((uint32_t *)aEepromData)[ESC_EEPROM_REVISION_NUM_WORD_INDEX / 2])) {
            require_init_eeprom = true;
        }
#endif
    } else if (status_fail == stat) {
        ECAT_LOG("I2C read ESC EEPROM content failed\n");
        return status_fail;
    } else {
        /* eeprom configuration data checksum error */
        require_init_eeprom = true;
    }

    if (require_init_eeprom) {
        ECAT_LOG("Init EEPROM content.\n");
        uint16_t subaddr;
        for (uint16_t addr = 0; addr < ESC_EEPROM_SIZE; addr += 8) {
            subaddr = ((addr & 0xff) << 8) | ((addr & 0xff00) >> 8);
            if (status_success != i2c_master_address_write(BOARD_ECAT_INIT_EEPROM_I2C, ESC_EEPROM_DEVICE_ADDRESS, (uint8_t *)&subaddr, 2, &aEepromData[addr], 8)) {
                ECAT_LOG("I2C init ESC EEPROM content failed\n");
                return status_fail;
            }
            board_delay_ms(10); /* delay for eeprom write process */
        }
        ECAT_LOG("Init EEPROM content successful.\n");
    } else {
        ECAT_LOG("No need to init EEPROM content.\n");
    }

    return status_success;
}
#endif
